AUTOSAR XML
3 x :
  ContainerB  # AA
  ContainerA  # BB
  ContainerC  # CC
